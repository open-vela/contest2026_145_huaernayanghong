## app/phoenix_agent_app/Kconfig
```kconfig
#
# Phoenix Agent App for OpenVela
# Contest 2026 team 145
#

config LVX_USE_DEMO_CONTEST2026_145_PHOENIX_AGENT_APP
	bool "Contest 2026 team 145 Phoenix Agent App"
	default n
	depends on GRAPHICS_LVGL
	select LIBUV
	select LV_FONT_MONTSERRAT_30
	---help---
		Enable the Phoenix Agent (AI IoT Assistant) LVGL application.
```
